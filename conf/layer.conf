## conf/layer.conf
```bitbake
# Add the conf and configuration classes to the BBPATH
BBPATH .= ":${LAYERDIR}"

# Add the recipes-* directories to the BBFILES
BBFILES += "${LAYERDIR}/recipes-*/*/*.bb \
            ${LAYERDIR}/recipes-*/*/*.bbappend"

BBFILE_COLLECTIONS += "app"
BBFILE_PATTERN_app = "^${LAYERDIR}/"
BBFILE_PRIORITY_app = "6"
```
